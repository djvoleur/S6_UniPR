## drivers/staging/snappy/Kconfig
```kconfig
config SNAPPY_COMPRESS
	select 	SNAPPY_DECOMPRESS
	tristate "Google Snappy Compression"

config SNAPPY_DECOMPRESS
	select SNAPPY_COMPRESS
	tristate "Google Snappy Decompression"
```
